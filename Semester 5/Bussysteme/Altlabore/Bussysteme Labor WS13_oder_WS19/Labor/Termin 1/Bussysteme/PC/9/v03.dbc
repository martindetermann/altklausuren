VERSION ""

NS_ :

BS_:

BU_:

BO_ 3221225472 VECTOR__INDEPENDENT_SIG_MSG: 0 Vector__XXX
 SG_ drehen : 0|8@0+ (1,0) [0|255] "links/rechts" Vector__XXX
 SG_ Zu_Heiss : 0|8@0- (1,0) [0|1] "" Vector__XXX

BO_ 800 Regeler: 8 Vector__XXX

BO_ 784 Schalter_Rechts: 8 Vector__XXX
 SG_ Schalter2 : 7|8@0+ (1,0) [0|0] "" Vector__XXX

BO_ 768 Schalter_Links: 8 Vector__XXX
 SG_ Schalter1 : 7|8@0+ (1,0) [0|255] "Runter" Vector__XXX

BO_ 1156 Servostellung: 1 Vector__XXX
 SG_ Servostellung : 7|8@0+ (1,0) [0|255] "" Vector__XXX

BO_ 272 Zu_Heiss: 1 Vector__XXX

BO_ 1928 Temperatur: 4 Vector__XXX
 SG_ Temperatur_Sensor2 : 23|16@0+ (0.003829656863,0) [0|100] "Grad Celsius" Vector__XXX
 SG_ Temperatur_Sensor1 : 7|16@0+ (0.003829656863,0) [0|100] "Grad Celsius" Vector__XXX

BO_ 1932 Spannung: 1 Vector__XXX
 SG_ Spannung : 7|8@0- (1,0) [0|100] "Prozent" Vector__XXX

BO_ 2040 Licht_Toggle: 1 Vector__XXX
 SG_ Licht : 7|8@0- (1,0) [0|255] "An" Vector__XXX

CM_ BO_ 3221225472 "This is a message for not used signals, created by Vector CANdb++ DBC OLE DB Provider.";

VERSION ""

NS_ :

BS_:

BU_:

BO_ 1156 Spannung_Servolenkung: 8 Vector__XXX
 SG_ Sensor : 7|8@0+ (1,0) [0|0] "V" Vector__XXX

BO_ 272 zu_Heiss: 8 Vector__XXX
 SG_ Aktor : 7|8@0- (1,0) [0|0] "Grad Celsius" Vector__XXX

BO_ 1928 Temperatur: 8 Vector__XXX
 SG_ Sensor : 7|8@0+ (1,0) [0|0] "Grad Celsius" Vector__XXX

BO_ 2040 Licht_Toggle: 8 Vector__XXX
 SG_ Licht : 7|8@0- (1,0) [0|0] "an/aus" Vector__XXX

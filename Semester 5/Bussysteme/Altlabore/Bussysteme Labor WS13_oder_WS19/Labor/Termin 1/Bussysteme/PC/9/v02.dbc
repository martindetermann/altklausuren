VERSION ""

NS_ :

BS_:

BU_:

BO_ 3221225472 VECTOR__INDEPENDENT_SIG_MSG: 0 Vector__XXX
 SG_ Zu_Heiss : 0|8@0- (1,0) [0|1] "" Vector__XXX

BO_ 272 Zu_Heiss: 1 Vector__XXX

BO_ 1928 Temperatur: 4 Vector__XXX
 SG_ Temperatur_Sensor2 : 23|16@0+ (0.003829656863,0) [0|100] "Grad Celsius" Vector__XXX
 SG_ Temperatur_Sensor1 : 7|16@0+ (0.003829656863,0) [0|100] "Grad Celsius" Vector__XXX

BO_ 1932 Spannung: 1 Vector__XXX
 SG_ Spannung : 7|8@0- (1,0) [0|100] "Prozent" Vector__XXX

BO_ 2040 Licht_Toggle: 1 Vector__XXX
 SG_ Licht : 7|8@0- (1,0) [0|255] "An/Aus" Vector__XXX

CM_ BO_ 3221225472 "This is a message for not used signals, created by Vector CANdb++ DBC OLE DB Provider.";

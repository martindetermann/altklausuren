VERSION ""

NS_ :

BS_:

BU_:
VAL_TABLE_ Licht 16 "An" 0 "Aus" ;
VAL_TABLE_ Backlight 255 "An" 0 "Aus" ;

BO_ 272 Lampe: 1 Vector__XXX
 SG_ Lampe : 0|8@1- (1,0) [0|0] "" Vector__XXX

BO_ 2040 Display: 1 Vector__XXX
 SG_ Display : 7|8@0+ (1,0) [0|255] "" Vector__XXX

BO_ 1156 Motor: 1 Vector__XXX
 SG_ Servo : 7|8@0+ (1,0) [0|0] "%" Vector__XXX

BO_ 1928 Temperatur: 4 Vector__XXX
 SG_ Temperatur_2 : 23|16@0+ (0.00390625,0) [0|0] "°C" Vector__XXX
 SG_ Temperatur_1 : 7|16@0+ (0.00390625,0) [0|255.99609375] "°C" Vector__XXX

VAL_ 272 Lampe 16 "An" 0 "Aus" ;
VAL_ 2040 Display 255 "An" 0 "Aus" ;
